/* USER CODE BEGIN Header */
/**
  ******************************************************************************
  * @file           : main.c
  * @brief          : Main program body
  ******************************************************************************
  * @attention
  *
  * Copyright (c) 2026 STMicroelectronics.
  * All rights reserved.
  *
  * This software is licensed under terms that can be found in the LICENSE file
  * in the root directory of this software component.
  * If no LICENSE file comes with this software, it is provided AS-IS.
  *
  ******************************************************************************
  */
/* USER CODE END Header */
/* Includes ------------------------------------------------------------------*/
#include "main.h"
#include "adc.h"
#include "dac.h"
#include "dma.h"
#include "spi.h"
#include "tim.h"
#include "usart.h"
#include "gpio.h"

/* Private includes ----------------------------------------------------------*/
/* USER CODE BEGIN Includes */
#include "arm_math.h"
#include <stdio.h>
#include <stdint.h>
#include <math.h>
#include "arm_const_structs.h"
#include "string.h"

void serialPrint(UART_HandleTypeDef *uart, uint8_t *message)
{
  HAL_UART_Transmit(uart, (uint8_t *)message, strlen(message), 500);
}

/* USER CODE END Includes */

/* Private typedef -----------------------------------------------------------*/
/* USER CODE BEGIN PTD */

/* USER CODE END PTD */

/* Private define ------------------------------------------------------------*/
/* USER CODE BEGIN PD */

#define SIGNAL_LENGTH 4096
#define ACQ_LENGTH 4096

#define ADJUST_FREQ_BINS //same signal length, but adapt freq bins
/* DUAL_CORE_BOOT_SYNC_SEQUENCE: Define for dual core boot synchronization    */
/*                             demonstration code based on hardware semaphore */
/* This define is present in both CM7/CM4 projects                            */
/* To comment when developping/debugging on a single core                     */
//#define DUAL_CORE_BOOT_SYNC_SEQUENCE

#if defined(DUAL_CORE_BOOT_SYNC_SEQUENCE)
#ifndef HSEM_ID_0
#define HSEM_ID_0 (0U) /* HW semaphore 0*/
#endif
#endif /* DUAL_CORE_BOOT_SYNC_SEQUENCE */

/* USER CODE END PD */

/* Private macro -------------------------------------------------------------*/
/* USER CODE BEGIN PM */

/* USER CODE END PM */

/* Private variables ---------------------------------------------------------*/

/* USER CODE BEGIN PV */

//uint16_t AdcBuffer1[ACQ_LENGTH] __attribute__((section(".RAM_D1"))) = {0};
//uint16_t AdcBuffer2[ACQ_LENGTH] __attribute__((section(".RAM_D1"))) = {0};

uint16_t AdcBuffer1[ACQ_LENGTH] = {0};
uint16_t AdcBuffer2[ACQ_LENGTH] = {0};

/* USER CODE END PV */

/* Private function prototypes -----------------------------------------------*/
void SystemClock_Config(void);
void PeriphCommonClock_Config(void);
/* USER CODE BEGIN PFP */

/* USER CODE END PFP */

/* Private user code ---------------------------------------------------------*/
/* USER CODE BEGIN 0 */

/* generated signal from  Make_multisine_RPG.m , freq=10kHz-200kHz, 12 freq_point, Fs = 5.1428571e6 */

#define R_SHUNT 1500.0f
#define NUMBER_OF_RUN 100
#define SIZE_F 15
uint32_t signal[SIGNAL_LENGTH] = {4029, 4039, 4047, 4055, 4062, 4068, 4074, 4079, 4083, 4086, 4089, 4090, 4091,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 4009, 4020};
int f_freqbins_map[SIZE_F] = {2, 3, 4, 5, 6, 7, 8, 9, 10, 11, 13, 14, 16, 18, 20};



uint8_t DmaCpltFlag1 = 0;
uint8_t DmaCpltFlag2 = 0;


volatile uint32_t runCount = 0;
volatile uint8_t  buttonPressed = 0;
float32_t accPhase[SIZE_F];
float32_t accMagnitude[SIZE_F];
float32_t accFactor = 0.999; //how much trust (0-1) to the old vlaue

/* USER CODE END 0 */

/**
  * @brief  The application entry point.
  * @retval int
  */
int main(void)
{

  /* USER CODE BEGIN 1 */

  /* USER CODE END 1 */
/* USER CODE BEGIN Boot_Mode_Sequence_0 */
#if defined(DUAL_CORE_BOOT_SYNC_SEQUENCE)
  int32_t timeout;
#endif /* DUAL_CORE_BOOT_SYNC_SEQUENCE */
/* USER CODE END Boot_Mode_Sequence_0 */

/* USER CODE BEGIN Boot_Mode_Sequence_1 */
#if defined(DUAL_CORE_BOOT_SYNC_SEQUENCE)
  /* Wait until CPU2 boots and enters in stop mode or timeout*/
  timeout = 0xFFFF;
  while((__HAL_RCC_GET_FLAG(RCC_FLAG_D2CKRDY) != RESET) && (timeout-- > 0));
  if ( timeout < 0 )
  {
  Error_Handler();
  }
#endif /* DUAL_CORE_BOOT_SYNC_SEQUENCE */
/* USER CODE END Boot_Mode_Sequence_1 */
  /* MCU Configuration--------------------------------------------------------*/

  /* Reset of all peripherals, Initializes the Flash interface and the Systick. */
  HAL_Init();

  /* USER CODE BEGIN Init */

  /* USER CODE END Init */

  /* Configure the system clock */
  SystemClock_Config();

  /* Configure the peripherals common clocks */
  PeriphCommonClock_Config();
/* USER CODE BEGIN Boot_Mode_Sequence_2 */
#if defined(DUAL_CORE_BOOT_SYNC_SEQUENCE)
/* When system initialization is finished, Cortex-M7 will release Cortex-M4 by means of
HSEM notification */
/*HW semaphore Clock enable*/
__HAL_RCC_HSEM_CLK_ENABLE();
/*Take HSEM */
HAL_HSEM_FastTake(HSEM_ID_0);
/*Release HSEM in order to notify the CPU2(CM4)*/
HAL_HSEM_Release(HSEM_ID_0,0);
/* wait until CPU2 wakes up from stop mode */
timeout = 0xFFFF;
while((__HAL_RCC_GET_FLAG(RCC_FLAG_D2CKRDY) == RESET) && (timeout-- > 0));
if ( timeout < 0 )
{
Error_Handler();
}
#endif /* DUAL_CORE_BOOT_SYNC_SEQUENCE */
/* USER CODE END Boot_Mode_Sequence_2 */

  /* USER CODE BEGIN SysInit */

  /* USER CODE END SysInit */

  /* Initialize all configured peripherals */
  MX_GPIO_Init();
  MX_DMA_Init();
  MX_ADC1_Init();
  MX_USART3_UART_Init();
  MX_ADC2_Init();
  MX_DAC1_Init();
  MX_TIM2_Init();
  MX_SPI1_Init();
  MX_TIM4_Init();
  /* USER CODE BEGIN 2 */

  //--------------------------------------------------- define
  // Here define what you would like to have (only 1)
   //#define SIGNAL_OUT
#define SIGNAL_OUT_SERIALPLOT_STYLE
//#define FFT
#define GOERTZEL



  //Do we need freq bins adjustments?
#ifdef ADJUST_FREQ_BINS
  for(int i = 0; i < SIZE_F; i++) f_freqbins_map[i] *= ACQ_LENGTH / SIGNAL_LENGTH;
#endif


  serialPrint(&huart3, "Project Codename: ColorfulFlower v1.1\r\n");
  serialPrint(&huart3, "Authors: Bilel Ben Atitallah & Ahmed Yahia Kallel\r\n");

  serialPrint(&huart3, "Starting DAC, TIM3, DMA\r\n");

  // Start DMA / DAC 3
  HAL_DAC_Start_DMA(&hdac1, DAC_CHANNEL_1, signal, SIGNAL_LENGTH, DAC_ALIGN_12B_R);
  HAL_TIM_Base_Start(&htim4);

  serialPrint(&huart3, "Calibrating ADCs\r\n");
  // Calibrate ADCs
  HAL_ADCEx_Calibration_Start(&hadc1, ADC_CALIB_OFFSET, ADC_SINGLE_ENDED);
  HAL_ADCEx_Calibration_Start(&hadc2, ADC_CALIB_OFFSET, ADC_SINGLE_ENDED);

  serialPrint(&huart3, "Starting ADC1/2, TIM2, DMA\r\n");
  // Start DMA & ADC 1/2
  HAL_ADC_Start_DMA(&hadc1, (uint32_t *)AdcBuffer1, ACQ_LENGTH);
  HAL_ADC_Start_DMA(&hadc2, (uint32_t *)AdcBuffer2, ACQ_LENGTH);

  HAL_TIM_Base_Start(&htim2);

  serialPrint(&huart3, "Forwarding to main loop...\r\n");

  /* USER CODE END 2 */

  /* Initialize leds */
  BSP_LED_Init(LED_GREEN);
  BSP_LED_Init(LED_YELLOW);
  BSP_LED_Init(LED_RED);

  /* Initialize USER push-button, will be used to trigger an interrupt each time it's pressed.*/
  BSP_PB_Init(BUTTON_USER, BUTTON_MODE_EXTI);

  /* Infinite loop */
  /* USER CODE BEGIN WHILE */
  while (1)
  {
    /* USER CODE END WHILE */

    /* USER CODE BEGIN 3 */
    if ((DmaCpltFlag1 == 1))
    {
      DmaCpltFlag1 = 0;

      // HAL_ADC_Stop_DMA(&hadc1);
      //  HAL_ADC_Stop_DMA(&hadc2);
      // HAL_DAC_Stop_DMA(&hdac1, DAC_CHANNEL_1);

      HAL_TIM_Base_Stop(&htim2);

      // HAL_Delay(1);

////////////////////////////////////////////////////// Out signal /////////////////////////////////
#ifdef SIGNAL_OUT
      char message[20];
      int cnt = 0;

      serialPrint(&huart3, "Signal writing...\r\n");
      for (cnt = 0; cnt < ACQ_LENGTH; cnt++)
      {

#ifdef SIGNAL_OUT_SERIALPLOT_STYLE
        sprintf(message, "%d,%d\r\n", AdcBuffer1[cnt], AdcBuffer2[cnt]);
        HAL_UART_Transmit(&huart3, (uint8_t *)message, strlen(message), 500);

#else
        sprintf(message, "ADC1(%4d)=%4d;\r\n", cnt + 1, AdcBuffer1[cnt]);
        HAL_UART_Transmit(&huart3, (uint8_t *)message, 18, 500);

        sprintf(message, "ADC2(%4d)=%4d;\r\n", cnt + 1, AdcBuffer2[cnt]);
        HAL_UART_Transmit(&huart3, (uint8_t *)message, 18, 500);

#endif

        //

        //	  	  		 	HAL_Delay(10);
      }
      serialPrint(&huart3, "Signal writing done\r\n");
#endif

////////////////////////////////////////////////////////// FFT ///////////////////////////////////////////////////////
#ifdef FFT

      //uint8_t message[50];

      float32_t Magnitude[SIZE_F];
      float32_t Magnitude1[SIZE_F];
      float32_t Magnitude2[SIZE_F];
      float32_t Phase[SIZE_F];
      float32_t Theta1[SIZE_F];
      float32_t Theta2[SIZE_F];

     float32_t fft_inputbuf[ACQ_LENGTH * 2];
     // int16_t fft_inputbuf[ACQ_LENGTH * 2];
      for (int i = 0; i < ACQ_LENGTH; i++)
      {

        fft_inputbuf[i * 2] = AdcBuffer1[i];
        fft_inputbuf[i * 2 + 1] = 0;
      }

      if(ACQ_LENGTH==2048)       arm_cfft_f32(&arm_cfft_sR_f32_len2048, fft_inputbuf, 0, 1);
      else if(ACQ_LENGTH == 4096) arm_cfft_f32(&arm_cfft_sR_f32_len4096, fft_inputbuf, 0, 1);

  //     if(ACQ_LENGTH==2048)       arm_cfft_q15(&arm_cfft_sR_q15_len2048, fft_inputbuf, 0, 1);
    //     else if(ACQ_LENGTH == 4096) arm_cfft_q15(&arm_cfft_sR_q15_len4096, fft_inputbuf, 0, 1);


      for (int i = 0; i < SIZE_F; i++)
      {

        float32_t in1 = fft_inputbuf[f_freqbins_map[i] * 2];
        float32_t in2 = fft_inputbuf[f_freqbins_map[i] * 2 + 1];
        Theta1[i] = atan2(in2, in1);

        float32_t input1 = fft_inputbuf[f_freqbins_map[i] * 2];
        float32_t input2 = fft_inputbuf[f_freqbins_map[i] * 2 + 1];
        Magnitude1[i] = (float)sqrt((input1 * input1) + (input2 * input2));

      } // FFT_ADC1_END

      // FFT_ADC2_ START
      for (int i = 0; i < ACQ_LENGTH; i++)
      {

        fft_inputbuf[i * 2] = AdcBuffer2[i];
        fft_inputbuf[i * 2 + 1] = 0;
      }

      if(ACQ_LENGTH==2048) arm_cfft_f32(&arm_cfft_sR_f32_len2048, fft_inputbuf, 0, 1);
      else if(ACQ_LENGTH == 4096) arm_cfft_f32(&arm_cfft_sR_f32_len4096, fft_inputbuf, 0, 1);

      //     if(ACQ_LENGTH==2048)       arm_cfft_q15(&arm_cfft_sR_q15_len2048, fft_inputbuf, 0, 1);
        //     else if(ACQ_LENGTH == 4096) arm_cfft_q15(&arm_cfft_sR_q15_len4096, fft_inputbuf, 0, 1);

      for (int i = 0; i < SIZE_F; i++)
      {

        float32_t in1 = fft_inputbuf[f_freqbins_map[i] * 2];
        float32_t in2 = fft_inputbuf[f_freqbins_map[i] * 2 + 1];
        Theta2[i] = atan2(in2, in1);

        float32_t input1 = fft_inputbuf[f_freqbins_map[i] * 2];
        float32_t input2 = fft_inputbuf[f_freqbins_map[i] * 2 + 1];

        Magnitude2[i] = (float)sqrt((input1 * input1) + (input2 * input2));

        Phase[i] = (float)((Theta1[i] - Theta2[i]) * (180 / PI)) + 180; //+90;
        Phase[i] = fmod(Phase[i] - 360, 360);
        Magnitude[i] = (float)(Magnitude1[i] / Magnitude2[i]) * R_SHUNT;

        //accumulate
        if (accPhase[i] == 0) accPhase[i] = Phase[i];
        if (accMagnitude[i] == 0) accMagnitude[i] = Magnitude[i];
        accPhase[i] = accPhase[i] * accFactor + Phase[i] * (1-accFactor);
        accMagnitude[i] = accMagnitude[i] * accFactor + Magnitude[i] * (1-accFactor);
      }

      for (int cnt = 0; cnt < SIZE_F; cnt++)
      {

#ifdef SIGNAL_OUT_SERIALPLOT_STYLE
    	  //Magnitude, Phase, accumulated magnitude, accumulated phase
        sprintf(message, "%d, %d.%d,%d.%d,%d.%d,%d.%d\r\n", cnt, (int)(Magnitude[cnt]),  (int)((fabs(Magnitude[cnt]) - (int)fabs(Magnitude[cnt])) * 1000),
        		(int)Phase[cnt], (int)((fabs(Phase[cnt]) - (int)fabs(Phase[cnt])) * 1000),
				(int)(accMagnitude[cnt]),  (int)((fabs(accMagnitude[cnt]) - (int)fabs(accMagnitude[cnt])) * 1000),
				(int)accPhase[cnt], (int)((fabs(accPhase[cnt]) - (int)fabs(accPhase[cnt])) * 1000)

        );
        HAL_UART_Transmit(&huart3, (uint8_t *)message, strlen(message), 500);

#else
        // Magnitude, Phase from UART
        sprintf(message, "Phas(%02d)=%d.%d;\r\n", cnt + 1, (int)Phase[cnt], (int)((fabs(Phase[cnt]) - (int)fabs(Phase[cnt])) * 1000));
        HAL_UART_Transmit(&huart3, (uint8_t *)message, strlen(message), 500);
        sprintf(message, "Magn(%02d)=%d.%d;\r\n", cnt + 1, (int)Magnitude[cnt], (int)((fabs(Magnitude[cnt]) - (int)fabs(Magnitude[cnt])) * 1000));
        HAL_UART_Transmit(&huart3, (uint8_t *)message, strlen(message), 500);
        sprintf(message, "AccPhas(%02d)=%d.%d;\r\n", cnt + 1, (int)accPhase[cnt], (int)((fabs(accPhase[cnt]) - (int)fabs(accPhase[cnt])) * 1000));
	   HAL_UART_Transmit(&huart3, (uint8_t *)message, strlen(message), 500);
	   sprintf(message, "AccMagn(%02d)=%d.%d;\r\n", cnt + 1, (int)accMagnitude[cnt], (int)((fabs(accMagnitude[cnt]) - (int)fabs(accMagnitude[cnt])) * 1000));
	   HAL_UART_Transmit(&huart3, (uint8_t *)message, strlen(message), 500);
#endif
      }

#endif


#ifdef GOERTZEL

      uint8_t message[50];
		#include "goertzel.h"
      float32_t Magnitude[SIZE_F];
      float32_t Phase[SIZE_F];
      goertzel_struct g1[SIZE_F];
      goertzel_struct_singlesideres gres1[SIZE_F];
      goertzel_struct g2[SIZE_F];
      goertzel_struct_singlesideres gres2[SIZE_F];

	  for(int k = 0; k< SIZE_F; k++) {
		  goertzel_init2(f_freqbins_map[k], ACQ_LENGTH, &g1[k]);
		  goertzel_init2(f_freqbins_map[k], ACQ_LENGTH, &g2[k]);

		  for(int i=0; i<ACQ_LENGTH; i++) {
			  goertzel(&g1[k], (double)AdcBuffer1[i]);
			    goertzel(&g2[k], (double)AdcBuffer2[i]);

			  //goertzel(&g1[k], (double)AdcBuffer1[i]/ACQ_LENGTH * powf(arm_sin_f32(pi*(float)i/ACQ_LENGTH),2));
			  //goertzel(&g2[k], (double)AdcBuffer2[i]/FFT_LENGTH * powf(arm_sin_f32(pi*(float)i/ACQ_LENGTH),2));
			//  goertzel(&g1[k], (float)AdcBuffer1[i]/ACQ_LENGTH * powf(arm_sin_f32(pi*(float)i/ACQ_LENGTH),2));
			//  goertzel(&g2[k], (float)AdcBuffer2[i]/ACQ_LENGTH * powf(arm_sin_f32(pi*(float)i/ACQ_LENGTH),2));

		  }

		  goertzel_end(&g1[k], &gres1[k], ACQ_LENGTH);
		  goertzel_end(&g2[k], &gres2[k], ACQ_LENGTH);

		  Magnitude[k] = R_SHUNT *gres2[k].M / gres1[k].M;
//		  Phase[k] =  fmod((float)((gres2[k].Phi-gres2[k].Phi)*(180/PI)) - 360, 360);  //+90;
		  Phase[k] = (float)((gres2[k].Phi - gres1[k].Phi) * (180 / PI));
		  if (Phase[k] > 180)  Phase[k] -= 360;
		  if (Phase[k] < -180) Phase[k] += 360;




		if (accPhase[k] == 0) accPhase[k] = Phase[k];
		if (accMagnitude[k] == 0) accMagnitude[k] = Magnitude[k];
		accPhase[k] = accPhase[k] * accFactor + Phase[k] * (1-accFactor);
		accMagnitude[k] = accMagnitude[k] * accFactor + Magnitude[k] * (1-accFactor);
	}

		      for (int cnt = 0; cnt < SIZE_F; cnt++) {

		#ifdef SIGNAL_OUT_SERIALPLOT_STYLE
		    	  //Magnitude, Phase, accumulated magnitude, accumulated phase
		        sprintf(message, "%d, %d.%d,%d.%d,%d.%d,%d.%d\r\n", cnt, (int)(Magnitude[cnt]),  (int)((fabs(Magnitude[cnt]) - (int)fabs(Magnitude[cnt])) * 1000),
		        		(int)Phase[cnt], (int)((fabs(Phase[cnt]) - (int)fabs(Phase[cnt])) * 1000),
						(int)(accMagnitude[cnt]),  (int)((fabs(accMagnitude[cnt]) - (int)fabs(accMagnitude[cnt])) * 1000),
						(int)accPhase[cnt], (int)((fabs(accPhase[cnt]) - (int)fabs(accPhase[cnt])) * 1000)

		        );
		        HAL_UART_Transmit(&huart3, (uint8_t *)message, strlen(message), 500);

		#else
		        // Magnitude, Phase from UART
		        sprintf(message, "Phas(%02d)=%d.%d;\r\n", cnt + 1, (int)Phase[cnt], (int)((fabs(Phase[cnt]) - (int)fabs(Phase[cnt])) * 1000));
		        HAL_UART_Transmit(&huart3, (uint8_t *)message, strlen(message), 500);
		        sprintf(message, "Magn(%02d)=%d.%d;\r\n", cnt + 1, (int)Magnitude[cnt], (int)((fabs(Magnitude[cnt]) - (int)fabs(Magnitude[cnt])) * 1000));
		        HAL_UART_Transmit(&huart3, (uint8_t *)message, strlen(message), 500);
		        sprintf(message, "AccPhas(%02d)=%d.%d;\r\n", cnt + 1, (int)accPhase[cnt], (int)((fabs(accPhase[cnt]) - (int)fabs(accPhase[cnt])) * 1000));
			   HAL_UART_Transmit(&huart3, (uint8_t *)message, strlen(message), 500);
			   sprintf(message, "AccMagn(%02d)=%d.%d;\r\n", cnt + 1, (int)accMagnitude[cnt], (int)((fabs(accMagnitude[cnt]) - (int)fabs(accMagnitude[cnt])) * 1000));
			   HAL_UART_Transmit(&huart3, (uint8_t *)message, strlen(message), 500);
		#endif
		      }
#endif
				  	  	//  	 sprintf(message, "toc;\r\n");


		      runCount++;
		      if (runCount < NUMBER_OF_RUN)
		          {

		            HAL_ADC_Start_DMA(&hadc1, (uint32_t *)AdcBuffer1, ACQ_LENGTH);
		            HAL_ADC_Start_DMA(&hadc2, (uint32_t *)AdcBuffer2, ACQ_LENGTH);
		            HAL_TIM_Base_Start(&htim2);
		          }
		      else
		          {
		          runCount = 0;
		          BSP_LED_On(LED_GREEN);
		          }

		      if (buttonPressed)
		      {
		        buttonPressed = 0;
		        BSP_LED_Off(LED_GREEN);

		        HAL_ADC_Start_DMA(&hadc1, (uint32_t *)AdcBuffer1, ACQ_LENGTH);
		        HAL_ADC_Start_DMA(&hadc2, (uint32_t *)AdcBuffer2, ACQ_LENGTH);
		        HAL_TIM_Base_Start(&htim2);
		      }


    }
  }
  /* USER CODE END 3 */
}

/**
  * @brief System Clock Configuration
  * @retval None
  */
void SystemClock_Config(void)
{
  RCC_OscInitTypeDef RCC_OscInitStruct = {0};
  RCC_ClkInitTypeDef RCC_ClkInitStruct = {0};

  /** Supply configuration update enable
  */
  HAL_PWREx_ConfigSupply(PWR_DIRECT_SMPS_SUPPLY);

  /** Configure the main internal regulator output voltage
  */
  __HAL_PWR_VOLTAGESCALING_CONFIG(PWR_REGULATOR_VOLTAGE_SCALE3);

  while(!__HAL_PWR_GET_FLAG(PWR_FLAG_VOSRDY)) {}

  /** Initializes the RCC Oscillators according to the specified parameters
  * in the RCC_OscInitTypeDef structure.
  */
  RCC_OscInitStruct.OscillatorType = RCC_OSCILLATORTYPE_HSI;
  RCC_OscInitStruct.HSIState = RCC_HSI_DIV1;
  RCC_OscInitStruct.HSICalibrationValue = RCC_HSICALIBRATION_DEFAULT;
  RCC_OscInitStruct.PLL.PLLState = RCC_PLL_ON;
  RCC_OscInitStruct.PLL.PLLSource = RCC_PLLSOURCE_HSI;
  RCC_OscInitStruct.PLL.PLLM = 4;
  RCC_OscInitStruct.PLL.PLLN = 9;
  RCC_OscInitStruct.PLL.PLLP = 2;
  RCC_OscInitStruct.PLL.PLLQ = 2;
  RCC_OscInitStruct.PLL.PLLR = 2;
  RCC_OscInitStruct.PLL.PLLRGE = RCC_PLL1VCIRANGE_3;
  RCC_OscInitStruct.PLL.PLLVCOSEL = RCC_PLL1VCOMEDIUM;
  RCC_OscInitStruct.PLL.PLLFRACN = 3072;
  if (HAL_RCC_OscConfig(&RCC_OscInitStruct) != HAL_OK)
  {
    Error_Handler();
  }

  /** Initializes the CPU, AHB and APB buses clocks
  */
  RCC_ClkInitStruct.ClockType = RCC_CLOCKTYPE_HCLK|RCC_CLOCKTYPE_SYSCLK
                              |RCC_CLOCKTYPE_PCLK1|RCC_CLOCKTYPE_PCLK2
                              |RCC_CLOCKTYPE_D3PCLK1|RCC_CLOCKTYPE_D1PCLK1;
  RCC_ClkInitStruct.SYSCLKSource = RCC_SYSCLKSOURCE_HSI;
  RCC_ClkInitStruct.SYSCLKDivider = RCC_SYSCLK_DIV1;
  RCC_ClkInitStruct.AHBCLKDivider = RCC_HCLK_DIV1;
  RCC_ClkInitStruct.APB3CLKDivider = RCC_APB3_DIV1;
  RCC_ClkInitStruct.APB1CLKDivider = RCC_APB1_DIV2;
  RCC_ClkInitStruct.APB2CLKDivider = RCC_APB2_DIV1;
  RCC_ClkInitStruct.APB4CLKDivider = RCC_APB4_DIV1;

  if (HAL_RCC_ClockConfig(&RCC_ClkInitStruct, FLASH_LATENCY_1) != HAL_OK)
  {
    Error_Handler();
  }
}

/**
  * @brief Peripherals Common Clock Configuration
  * @retval None
  */
void PeriphCommonClock_Config(void)
{
  RCC_PeriphCLKInitTypeDef PeriphClkInitStruct = {0};

  /** Initializes the peripherals clock
  */
  PeriphClkInitStruct.PeriphClockSelection = RCC_PERIPHCLK_ADC;
  PeriphClkInitStruct.PLL2.PLL2M = 4;
  PeriphClkInitStruct.PLL2.PLL2N = 10;
  PeriphClkInitStruct.PLL2.PLL2P = 2;
  PeriphClkInitStruct.PLL2.PLL2Q = 2;
  PeriphClkInitStruct.PLL2.PLL2R = 2;
  PeriphClkInitStruct.PLL2.PLL2RGE = RCC_PLL2VCIRANGE_3;
  PeriphClkInitStruct.PLL2.PLL2VCOSEL = RCC_PLL2VCOMEDIUM;
  PeriphClkInitStruct.PLL2.PLL2FRACN = 0;
  PeriphClkInitStruct.AdcClockSelection = RCC_ADCCLKSOURCE_PLL2;
  if (HAL_RCCEx_PeriphCLKConfig(&PeriphClkInitStruct) != HAL_OK)
  {
    Error_Handler();
  }
}

/* USER CODE BEGIN 4 */
void HAL_ADC_ConvCpltCallback(ADC_HandleTypeDef *hadc)
{
  DmaCpltFlag1 = 1;
}

void HAL_GPIO_EXTI_Callback(uint16_t GPIO_Pin)
{
	  static uint32_t lastPress = 0;
	  uint32_t now = HAL_GetTick();

	  if (GPIO_Pin == BUTTON_USER_PIN)   // <-- đổi thành macro pin thật của board bạn
	  {
	    if ((now - lastPress) > 200)     // debounce phần mềm 200ms
	    {
	      buttonPressed = 1;
	      lastPress = now;
	    }
	  }
}


/* USER CODE END 4 */

/**
  * @brief  This function is executed in case of error occurrence.
  * @retval None
  */
void Error_Handler(void)
{
  /* USER CODE BEGIN Error_Handler_Debug */
  /* User can add his own implementation to report the HAL error return state */
  __disable_irq();
  while (1)
  {
  }
  /* USER CODE END Error_Handler_Debug */
}
#ifdef USE_FULL_ASSERT
/**
  * @brief  Reports the name of the source file and the source line number
  *         where the assert_param error has occurred.
  * @param  file: pointer to the source file name
  * @param  line: assert_param error line source number
  * @retval None
  */
void assert_failed(uint8_t *file, uint32_t line)
{
  /* USER CODE BEGIN 6 */
  /* User can add his own implementation to report the file name and line number,
     ex: printf("Wrong parameters value: file %s on line %d\r\n", file, line) */
  /* USER CODE END 6 */
}
#endif /* USE_FULL_ASSERT */
